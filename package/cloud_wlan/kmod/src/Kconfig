## package/cloud_wlan/kmod/src/Kconfig
```kconfig
config zt_wlan
	bool "cloud wlan support"
	tristate cloud wlan support”
	default n
	help
		This is a cloud wlan mode, for debugging kernel model.
		If unsure, say N.
```
